## app/src/split/Kconfig
```kconfig
# Copyright (c) 2022 The ZMK Contributors
# SPDX-License-Identifier: MIT

menuconfig ZMK_SPLIT
    bool "Split keyboard support"

if ZMK_SPLIT

config ZMK_SPLIT_ROLE_CENTRAL
    bool "Split central device"

config ZMK_SPLIT_BLE
    bool "BLE Split"
    default y
    depends on ZMK_BLE
    select BT_USER_PHY_UPDATE
    select BT_AUTO_PHY_UPDATE

config ZMK_SPLIT_WIRED
    bool "Wired Split"
    default y
    depends on DT_HAS_ZMK_WIRED_SPLIT_ENABLED
    select SERIAL
    select RING_BUFFER
    select CRC

config ZMK_SPLIT_PERIPHERAL_HID_INDICATORS
    bool "Peripheral HID Indicators"
    depends on ZMK_HID_INDICATORS
    help
      Enable propagating the HID (LED) Indicator state to the split peripheral(s).

config ZMK_SPLIT_SYNC_LAST_ACTIVITY_TIMING_PERIODIC
    bool "Sync last activity timing across all devices periodically"
    default n
    help
        Sync central device last activity timing to the split peripheral(s) with a periodic interval.
        Does not help to wake up peripheral devices that have gone to deep sleep.

        NOTE: Enabling both PERIODIC and ON_EVENT modes simultaneously will work but may
        increase power consumption. For best battery life, choose only one sync mode.

config ZMK_SPLIT_SYNC_LAST_ACTIVITY_TIMING_PERIODIC_INTERVAL_MS
    int "Last activity time periodic sync interval in milliseconds"
    default 30000
    depends on ZMK_SPLIT_SYNC_LAST_ACTIVITY_TIMING_PERIODIC

config ZMK_SPLIT_SYNC_LAST_ACTIVITY_TIMING_ON_EVENT
    bool "Sync last activity timing across all devices upon central activity event"
    default n
    help
        Sync central device last activity timing to the split peripheral(s) when an event (key press/sensor)
        is detected. Does not help to wake up peripheral devices that have gone to deep sleep.
        Optimized to send only significant changes, reducing BLE traffic during active typing.

        NOTE: Enabling both PERIODIC and ON_EVENT modes simultaneously will work but may
        increase power consumption. For best battery life, choose only one sync mode.
        Recommended mode for most users.

config ZMK_SPLIT_SYNC_LAST_ACTIVITY_TIMING_EVENT_MIN_INTERVAL
    int "Sync timings on events (key/sensors presses) as well, 0 to disable. Represents minimum interval in milliseconds"
    default 1000
    depends on ZMK_SPLIT_SYNC_LAST_ACTIVITY_TIMING_ON_EVENT

endif # ZMK_SPLIT

rsource "bluetooth/Kconfig"
rsource "wired/Kconfig"
```
